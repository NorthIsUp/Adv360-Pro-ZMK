## config/west.yml
```yaml
manifest:
  remotes:
    - name: zmkfirmware
      url-base: https://github.com/zmkfirmware
    - name: northisup
      url-base: https://github.com/NorthIsUp
  projects:
    - name: zmk
      remote: northisup
      revision: zmk-v0.3.0-192-g5b51501f-adv360.2
      import: app/west.yml
  self:
    path: config
```
